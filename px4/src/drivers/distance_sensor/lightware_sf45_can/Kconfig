## px4/src/drivers/distance_sensor/lightware_sf45_can/Kconfig
```kconfig
menuconfig DRIVERS_DISTANCE_SENSOR_LIGHTWARE_SF45_CAN
    bool "lightware_sf45_can"
    depends on DRIVERS_UAVCAN
    default n
    help
        Standalone SF45 obstacle-map module fed by the existing DroneCAN stack.
```

## px4/src/modules/simulink_guidance/Kconfig
```kconfig
menuconfig MODULES_SIMULINK_GUIDANCE
	bool "simulink_guidance"
	default n
	---help---
		Enable support for simulink_guidance

menuconfig USER_SIMULINK_GUIDANCE
	bool "simulink_guidance running as userspace module"
	default n
	depends on BOARD_PROTECTED && MODULES_SIMULINK_GUIDANCE
	---help---
		Put simulink_guidance in userspace memory
```

## px4/src/modules/simulink_io/Kconfig
```kconfig
menuconfig MODULES_SIMULINK_IO
	bool "simulink_io module"
	default n
	---help---
		Enable support for the standalone auto-generated Simulink IO module.
```
